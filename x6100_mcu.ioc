# file: x6100_mcu.ioc
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ARM.CMSIS-DSP.1.16.2.CMSISJjDSP=Source
Mcu.Family=STM32F4
Mcu.Name=STM32F427Z(G-I)Tx
Mcu.Package=LQFP144
NVIC.PriorityGroup=NVIC_PRIORITYGROUP_4
ProjectManager.HeapSize=0x200
ProjectManager.StackSize=0x400
ProjectManager.TargetToolchain=CMake
RCC.AHBFreq_Value=16000000
RCC.APB1Freq_Value=16000000
RCC.APB2Freq_Value=16000000
RCC.CortexFreq_Value=16000000
RCC.HSE_VALUE=25000000
RCC.HSI_VALUE=16000000
RCC.LSE_VALUE=32768
RCC.SYSCLKFreq_VALUE=16000000
RCC.VCOOutputFreq_Value=192000000
VP_ARM.CMSIS-DSP_VS_CMSISJjDSP_1.16.2_1.16.2.Mode=CMSISJjDSP
board=custom

// file: Core/Src/main.c
/* USER CODE BEGIN Header */
/**
  ******************************************************************************
  * @file           : main.c
  * @brief          : Main program body
  ******************************************************************************
  * @attention
  *
  * Copyright (c) 2025 STMicroelectronics.
  * All rights reserved.
  *
  * This software is licensed under terms that can be found in the LICENSE file
  * in the root directory of this software component.
  * If no LICENSE file comes with this software, it is provided AS-IS.
  *
  ******************************************************************************
  */
/* USER CODE END Header */
#include "main.h"

/* USER CODE BEGIN Includes */
#include "compressor.h"
#include "noise_reduction.h"
#include "noise_blanker.h"
#include "vox.h"
#include "aic3204.h"
#include "cw_peak.h"
#include "cessb.h"
#include "comm.h"
/* USER CODE END Includes */

void SystemClock_Config(void);

int main(void)
{

  /* USER CODE BEGIN 1 */
  init_data();
  compress(NULL);
  fm_demodulate(NULL, NULL, NULL, 1);
  am_fm_rx_process();
  configure();
  dma_end();
  nr_init();
  nr_apply(1.0f);
  vox_update(1.0f);
  vox_restore_audio_input(0, 0, 0);
  aic_setup_adc_dc_blocker();
  // nr_setup_filters();
  /* USER CODE END 1 */

  /* MCU Configuration--------------------------------------------------------*/

  /* Reset of all peripherals, Initializes the Flash interface and the Systick. */
  // HAL_Init();

  /* Configure the system clock */
  // SystemClock_Config();

  /* Initialize all configured peripherals */

  /* Infinite loop */
  while (1)
  {
    float a, b;
    tx_amp(&a, &b);
    tx_coeff_calc(a);
    apply_rx_iq_offset();
    GPIOA->IDR;
    anf_update();
    copy_flow(&a);
    process_i2c_cmd();
    if_shift_rx();
    if_shift_tx(1);
    a = am_modulation(a, b, 1.0f);
    b = fm_modulate(a);
    b = cw_peak_process(b);
    nr_apply(a);
    nb_apply((cfloat_t){a, b});
    int32_t ai;
    remove_iq_offset(&ai);
    cessb_process(&a, &b);
    update_flow_data();
    aic_pll_setup(NULL, 123);
  }
}

void SystemClock_Config(void)
{
  // RCC_OscInitTypeDef RCC_OscInitStruct = {0};
  // RCC_ClkInitTypeDef RCC_ClkInitStruct = {0};

  // /** Configure the main internal regulator output voltage
  // */
  // __HAL_RCC_PWR_CLK_ENABLE();
  // __HAL_PWR_VOLTAGESCALING_CONFIG(PWR_REGULATOR_VOLTAGE_SCALE3);

  // /** Initializes the RCC Oscillators according to the specified parameters
  // * in the RCC_OscInitTypeDef structure.
  // */
  // RCC_OscInitStruct.OscillatorType = RCC_OSCILLATORTYPE_HSI;
  // RCC_OscInitStruct.HSIState = RCC_HSI_ON;
  // RCC_OscInitStruct.HSICalibrationValue = RCC_HSICALIBRATION_DEFAULT;
  // RCC_OscInitStruct.PLL.PLLState = RCC_PLL_NONE;
  // if (HAL_RCC_OscConfig(&RCC_OscInitStruct) != HAL_OK)
  // {
  //   Error_Handler();
  // }

  // /** Initializes the CPU, AHB and APB buses clocks
  // */
  // RCC_ClkInitStruct.ClockType = RCC_CLOCKTYPE_HCLK|RCC_CLOCKTYPE_SYSCLK
  //                             |RCC_CLOCKTYPE_PCLK1|RCC_CLOCKTYPE_PCLK2;
  // RCC_ClkInitStruct.SYSCLKSource = RCC_SYSCLKSOURCE_HSI;
  // RCC_ClkInitStruct.AHBCLKDivider = RCC_SYSCLK_DIV1;
  // RCC_ClkInitStruct.APB1CLKDivider = RCC_HCLK_DIV1;
  // RCC_ClkInitStruct.APB2CLKDivider = RCC_HCLK_DIV1;

  // if (HAL_RCC_ClockConfig(&RCC_ClkInitStruct, FLASH_LATENCY_0) != HAL_OK)
  // {
  //   Error_Handler();
  // }
}

void Error_Handler(void)
{
  /* USER CODE BEGIN Error_Handler_Debug */
  /* User can add his own implementation to report the HAL error return state */
  // __disable_irq();
  while (1)
  {

  }
  /* USER CODE END Error_Handler_Debug */
}
